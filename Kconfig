## Kconfig
```kconfig
config ZMK_BEHAVIOR_MKP_QUICK_EXIT
    bool "Mouse key press with delayed layer-deactivate on release"
    default y
    depends on DT_HAS_ZMK_BEHAVIOR_MKP_QUICK_EXIT_ENABLED
    depends on !ZMK_SPLIT || ZMK_SPLIT_ROLE_CENTRAL

config ZMK_INPUT_PROCESSOR_TRACKBALL_GESTURE
    bool "Trackball gesture input processor"
    default y
    depends on DT_HAS_ZMK_INPUT_PROCESSOR_TRACKBALL_GESTURE_ENABLED
    depends on !ZMK_SPLIT || ZMK_SPLIT_ROLE_CENTRAL

config ZMK_INPUT_PROCESSOR_MOTION_NOTE
    bool "Pointer activity timestamp input processor"
    default y
    depends on DT_HAS_ZMK_INPUT_PROCESSOR_MOTION_NOTE_ENABLED
    depends on !ZMK_SPLIT || ZMK_SPLIT_ROLE_CENTRAL
```

## config/west.yml
```yaml
manifest:
  remotes:
    - name: zmkfirmware
      url-base: https://github.com/zmkfirmware
    - name: tact-software
      url-base: https://github.com/tact-software
  projects:
    - name: zmk
      remote: zmkfirmware
      revision: v0.3-branch
      import: app/west.yml
    # 自アカウントのフォーク (Dist16384系、Cygnusと同一ドライバ・同一コミット)。
    # AUTO_RECOVERY (初期化リトライ + 3秒毎ヘルスチェックによる自動再初期化) が
    # 熱起因のセンサー脱落への対策になる。問題が出た場合は
    # CONFIG_PMW3610_HEALTH_VERIFY_CONFIG=n で読み戻し検証だけ無効化できる。
    - name: zmk-pmw3610-driver
      remote: tact-software
      revision: c5e190c90bd03dc450105fde12d676bc34e6825e
  self:
    path: config
```

## dts/bindings/behaviors/zmk,behavior-mkp-quick-exit.yaml
```yaml
description: |
  Mouse button press that schedules a layer deactivation after a short delay
  upon release. Repeated presses cancel and reschedule the pending deactivation.

  param1 is the mouse button. param2 is an optional fallback keycode: when it
  and motion-grace-ms are both non-zero, a press with no pointer activity
  (trackball motion / previous click) within the last motion-grace-ms sends
  the fallback keycode instead of the mouse button, so typing shortly after
  mouse use produces letters again. Pass 0 to keep unconditional clicks.

compatible: "zmk,behavior-mkp-quick-exit"

include: two_param.yaml

properties:
  layer:
    type: int
    required: true
  timeout-ms:
    type: int
    default: 500
  motion-grace-ms:
    type: int
    default: 0
    description: Pointer-activity window in ms for the fallback gate (0 = off).
```

## dts/bindings/input_processors/zmk,input-processor-motion-note.yaml
```yaml
description: |
  Pass-through input processor that records the uptime of the last relative
  pointer event (motion or wheel) for the mkp-quick-exit behavior's typing
  gate. It never modifies or consumes events.

compatible: "zmk,input-processor-motion-note"

include: ip_zero_param.yaml
```

## dts/bindings/input_processors/zmk,input-processor-trackball-gesture.yaml
```yaml
description: |
  Trackball gesture input processor. While the configured gesture layer is
  active it consumes trackball motion, resolves a forced 4-way direction and
  emits OS-specific keyboard shortcuts. UP/DOWN are single taps; LEFT/RIGHT are
  continuous (a held modifier plus one key tap per movement step).

  All per-direction array properties take exactly two entries ordered as
  <windows macos>. The OS is selected at runtime from "windows-layer": when that
  layer is active the Windows value is used, otherwise the macOS value.

compatible: "zmk,input-processor-trackball-gesture"

include: ip_zero_param.yaml

properties:
  layer:
    type: int
    required: true
    description: Layer index that activates this gesture instance.
  windows-layer:
    type: int
    required: true
    description: When active, shortcuts are sent for Windows; otherwise macOS.

  start-threshold:
    type: int
    default: 15
    description: Accumulated abs(dx)+abs(dy) required to start a gesture.
  stop-timeout-ms:
    type: int
    default: 100
    description: Idle time after the last motion that ends/commits the gesture.
  direction-ratio-x10:
    type: int
    default: 20
    description: 4-way dominance ratio as fixed point x10 (20 == 2.0).
  step-threshold:
    type: int
    default: 70
    description: Counts of primary-axis travel per continuous step.

  invert-x:
    type: boolean
    description: Negate the X axis (calibration for trackball mounting).
  invert-y:
    type: boolean
    description: Negate the Y axis (calibration for trackball mounting).
  swap-xy:
    type: boolean
    description: Swap X and Y axes (calibration for trackball mounting).

  up-keys:
    type: array
    required: true
    description: "<windows macos> keycode tapped once on UP."
  down-keys:
    type: array
    required: true
    description: "<windows macos> keycode tapped once on DOWN."
  left-keys:
    type: array
    required: true
    description: "<windows macos> keycode tapped per step on LEFT."
  right-keys:
    type: array
    required: true
    description: "<windows macos> keycode tapped per step on RIGHT."
  left-mods:
    type: array
    required: true
    description: "<windows macos> modifier held during a LEFT gesture (0 = none)."
  right-mods:
    type: array
    required: true
    description: "<windows macos> modifier held during a RIGHT gesture (0 = none)."
```
